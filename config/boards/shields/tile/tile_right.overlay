#include "tile.dtsi"

&default_transform {
    col-offset = <5>;
};

&kscan0 {
    col-gpios
        = <&gpio0 17 GPIO_ACTIVE_HIGH> 
        , <&gpio1 4 GPIO_ACTIVE_HIGH>  
        , <&gpio1 6 GPIO_ACTIVE_HIGH> 
        , <&gpio0 8 GPIO_ACTIVE_HIGH> 
        , <&gpio0 6 GPIO_ACTIVE_HIGH> 
        ;
};
